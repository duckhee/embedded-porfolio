## library/Kconfig
```kconfig
###############################################################################
# SPDX-License-Identifier: GPL-3.0-or-later
###############################################################################

config FAT_FS
    bool "Select FatFS Library"
    default n

config LWIP
    bool "Select LwIP Library"
    default n

###############################################################################
```
