## CMSIS/Kconfig
```kconfig
###############################################################################
# SPDX-License-Identifier: GPL-3.0-or-later
###############################################################################

config ARCH_M3
    bool "architecture Cortex-m3"
    default n

config ARCH_M4
    bool "architecture Cortex-m4"
    default n    

###############################################################################
```

## Kconfig
```kconfig
###############################################################################
# SPDX-License-Identifier: GPL-3.0-or-later
###############################################################################

mainmenu "Make Project"

# Board Select menu
menu "Select MCU Board Menu"
    source "MCU-Board/Kconfig"
endmenu

# MCU Board Select Core Architecture 
menu "Select MCU Core Architecture Menu"
    source "CMSIS/Kconfig"
endmenu

# Driver Select Menu
menu "Select Driver"
    source "driver/Kconfig"
endmenu

# Sub Library Menu
menu "Select Library"
    source "library/Kconfig"
endmenu

# Study Sample Code
menu "Lecture or Study Sample Code Menu"
    source "StudyCode/Kconfig"
endmenu


###############################################################################
```

## LinkerScripts/Kconfig
```kconfig
###############################################################################
# SPDX-License-Identifier: GPL-3.0-or-later
###############################################################################

# select Linker

config STM32F10x
bool "STM32F10x Linker"
default n

config STM32F407
bool "STM32F407 Linker"
default n

###############################################################################
```

## MCU-Board/Kconfig
```kconfig
###############################################################################
# SPDX-License-Identifier: GPL-3.0-or-later
###############################################################################

config MANGO_M3
    bool "Select mango-M3 Board (Embedded Crazy Boys)"
    default n

config MANGO_Z1
    bool "Select mango-Z1 Board (Embedded Crazy Boys)"
    default n

config MANGO_M32F2
    bool "Select mango-M32F2 Board (Embedded Crazy Boys)"
    default n

config MANGO_M32F4
    bool "Select mango-M32F4 Board (Embedded Crazy Boys)"
    default n

config M_HIVE
    bool "Select STM32F407V EduBoard V1.2 (ChrisP)"
    default n

###############################################################################
```

## StudyCode/Kconfig
```kconfig
###############################################################################
# SPDX-License-Identifier: GPL-3.0-or-later
###############################################################################

# mstory2.0 Book
menu "Mstory2.0 Book Chapter Code"
    source "StudyCode/MSTORY2.0/Kconfig"
endmenu

# mstory3.0 Book
menu "Mstory3.0 Book Chapter Code"
    source "StudyCode/MSTORY3.0/Kconfig"
endmenu

# M-Hive Edu Board Lecture Code
menu "M-HIVE EduBoard Lecture Code M4 Core"
    source "StudyCode/M-HIVE-EduBoard/Kconfig"
endmenu

###############################################################################
```

## StudyCode/M-HIVE-EduBoard/cubeMXstudy/Kconfig
```kconfig
###############################################################################
# SPDX-License-Identifier: GPL-3.0-or-later
###############################################################################

# GPIO
config H_HIVE_EDU_BOARD_SIMPLE_LED
    bool "select EduBoard M-Hive Simple LED"
    default n
    select ARCH_M4
    select HAL_DRIVER
    select M_HIVE_EDU_BOARD

config H_HIVE_EDU_BOARD_SIMPLE_UART
    bool "select EduBoard M-Hive Simple UART Communication"
    default n
    select ARCH_M4
    select HAL_DRIVER
    select M_HIVE_EDU_BOARD

config H_HIVE_EDU_BOARD_SIMPLE_UART_PRINTF
    bool "select EduBoard M-Hive Simple UART PRINTF"
    default n
    select ARCH_M4
    select HAL_DRIVER
    select M_HIVE_EDU_BOARD

config H_HIVE_EDU_BOARD_UART_RECEIVE_INTERRUPT
    bool "select EduBoard M-Hive UART Receive Interrupt"
    default n
    select ARCH_M4
    select HAL_DRIVER
    select M_HIVE_EDU_BOARD

config H_HIVE_EDU_BOARD_CHARACTER_LCD_OUTPUT
    bool "select EduBoard M-Hive Character LCD Write"
    default n
    select ARCH_M4
    select HAL_DRIVER
    select M_HIVE_EDU_BOARD

config H_HIVE_EDU_BOARD_TIME_TIMER
    bool "select EduBoard M-Hive TIM Timer LED Toggle"
    default n
    select ARCH_M4
    select HAL_DRIVER
    select M_HIVE_EDU_BOARD

config H_HIVE_EDU_BOARD_TIME_TIMER_SEG
    bool "select EduBoard M-Hive TIM Timer Segment Count"
    default n
    select ARCH_M4
    select HAL_DRIVER
    select M_HIVE_EDU_BOARD

config H_HIVE_EDU_BOARD_EXTI_INPUT
    bool "select EduBoard M-Hive EXTI GPIO Input"
    default n
    select ARCH_M4
    select HAL_DRIVER
    select M_HIVE_EDU_BOARD

config H_HIVE_EDU_BOARD_PWM_BASIC
    bool "select EduBoard M-Hive PWM Basic Pulse Width"
    default n
    select ARCH_M4
    select HAL_DRIVER
    select M_HIVE_EDU_BOARD

config H_HIVE_EDU_BOARD_PWM_SERVO_MOTOR
    bool "Select EduBoard M-Hive PWM SERVO90 Motor Operator"
    default n
    select ARCH_M4
    select HAL_DRIVER
    select M_HIVE_EDU_BOARD

config H_HIVE_EDU_BOARD_PWM_BUZZER
    bool "Select EduBoard M-Hive PWM Passive Buzzer"
    default n
    select ARCH_M4
    select HAL_DRIVER
    select M_HIVE_EDU_BOARD

config H_HIVE_EDU_BOARD_PWM_MOTOR
    bool "Select EduBoard M-Hive PWM DC Motor -> BA6208 Motor Driver"
    default n
    select ARCH_M4
    select HAL_DRIVER
    select M_HIVE_EDU_BOARD

config H_HIVE_EDU_BOARD_PWM_REPEAT_CYCLE
    bool "Select EduBoard M-Hive PWM repeat cycle -> safe change pre scaler"
    default n
    select ARCH_M4
    select HAL_DRIVER
    select M_HIVE_EDU_BOARD

config H_HIVE_EDU_BOARD_ADC_WITH_DMA
    bool "Select EduBoard M-Hive ADC with DMA"
    default n
    select ARCH_M4
    select HAL_DRIVER
    select M_HIVE_EDU_BOARD

config H_HIVE_EDU_BOARD_DAC
    bool "Select EduBoard M-Hive DAC Sin pulse out"
    default n
    select ARCH_M4
    select HAL_DRIVER
    select M_HIVE_EDU_BOARD

config H_HIVE_EDU_BOARD_I2C_EEPROM
    bool "Select EduBoard M-Hive I2C EEPROM"
    default n
    select ARCH_M4
    select HAL_DRIVER
    select M_HIVE_EDU_BOARD

###############################################################################
```

## StudyCode/MSTORY2.0/Kconfig
```kconfig
###############################################################################
# SPDX-License-Identifier: GPL-3.0-or-later
###############################################################################

# select MCU Develop Board

menu "Mango M-3 Board Sample Code in Mstroy2.0 Book"
    source "StudyCode/MSTORY2.0/Mango-M3_Board/Kconfig"
endmenu

menu "Mango Z-1 Board Sample Code in Mstory2.0 Book"
    source "StudyCode/MSTORY2.0/Mango-Z1_Board/Kconfig"
endmenu

###############################################################################
```

## StudyCode/MSTORY2.0/Mango-M3_Board/Kconfig
```kconfig
###############################################################################
# SPDX-License-Identifier: GPL-3.0-or-later
###############################################################################

# select Mango-M3 Board Simple LED On
config MANGO_M3_BOARD_SIMPLE_LED_ON
    bool "select mango-M3 Board Simple LED On Sample"
    default n
    select ARCH_M3

# select Mango-M3 Board Simple LED Blink
config MANGO_M3_BOARD_SIMPLE_LED_BLINK_ONCE
    bool "select mango-M3 Board Simple LED Blink Once"
    default n
    select ARCH_M3

# select Mango-M3 Board Simple All LED Blink 
config MANGO_M3_BOARD_SIMPLE_ALL_LED_BLINK
    bool "select mango-M3 Board Simple LED All Blink"
    default n
    select ARCH_M3

# select Mango-M3 Board led control with mango register define header file
config MANGO_M3_BOARD_LED_CONTROL_WITH_DEFINE
    bool "select mango-M3 Board LED Control define register map by header file"
    default n
    select ARCH_M3

# select Mango-M3 Board led control with mango register map setting define using address offset
config MANGO_BOARD_LED_CONTROL_ADDRESS_OFFSET
    bool "select mango-M3 Board LED Control using address offset using memory map define"
    default n
    select ARCH_M3

# select Mango-M3 Board key press
config MANGO_BOARD_KEY_PRESS
    bool "select mango-M3 Board Key Press Tests"
    default n
    select ARCH_M3

# select Mango-M3 Board Hello World UART
config UART_HELLO_WORLD
    bool "select mango-M3 Board UART Hello World"
    default n
    select ARCH_M3

# select Mango-M3 Board Hello World Using redefine standardIO
config USART_STANDARD_IO_HELLO_WORLD
    bool "select mango-M3 Board USART Set Standard IO"
    default n
    select ARCH_M3

config RECEIVE_USART_DATA
    bool "select mango-M3 Board USART Receive Data"
    default n
    select ARCH_M3

###############################################################################
```

## StudyCode/MSTORY3.0/Kconfig
```kconfig
###############################################################################
# SPDX-License-Identifier: GPL-3.0-or-later
###############################################################################

menu "Mango M-3 Board Sample Code in Mstroy3.0 Book"
    source "StudyCode/MSTORY3.0/Mango-M3_Board/Kconfig"
endmenu

menu "Mango Z-1 Board Sample Code in Mstory3.0 Book"
    source "StudyCode/MSTORY3.0/Mango-Z1_Board/Kconfig"
endmenu


###############################################################################
```

## driver/Kconfig
```kconfig
###############################################################################
# SPDX-License-Identifier: GPL-3.0-or-later
###############################################################################

config STANDARD_DRIVER
    bool "Standard Driver Select"
    default n

config HAL_DRIVER
    bool "Hal Driver Select"
    default n


###############################################################################
```
